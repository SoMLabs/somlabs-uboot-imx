/*
 * Copyright (C) 2020 Somlabs
 *
 * This program is free software; you can redistribute it and/or modify
 * it under the terms of the GNU General Public License version 2 as
 * published by the Free Software Foundation.
 */
/dts-v1/;

#include "imx6ull.dtsi"
#include "imx6ul-visionsom.dtsi"

/ {
	model = "SomLabs VisionSOM-6ULL";
	compatible = "fsl,imx6ull";
};
