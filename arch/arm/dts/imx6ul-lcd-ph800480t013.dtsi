
&lcdif {
        display0: display {
                bits-per-pixel = <24>;
                bus-width = <24>;

                display-timings {
                        native-mode = <&timing0>;
                        timing0: timing0 {
                                clock-frequency = <33300000>;
                                hactive = <800>;
                                vactive = <480>;
                                hfront-porch = <210>;
                                hback-porch = <46>;
                                hsync-len = <20>;
                                vback-porch = <23>;
                                vfront-porch = <22>;
                                vsync-len = <10>;

                                hsync-active = <0>;
                                vsync-active = <0>;
                                de-active = <1>;
                                pixelclk-active = <0>;
                        };
                };
        };
};
