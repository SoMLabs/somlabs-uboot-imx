
&lcdif {
        display0: display {
                bits-per-pixel = <24>;
                bus-width = <24>;

                display-timings {
                        native-mode = <&timing0>;
                        timing0: timing0 {
                                clock-frequency = <51000000>;
                                hactive = <1024>;
                                vactive = <600>;
                                hfront-porch = <160>;
                                hback-porch = <160>;
                                hsync-len = <10>;
                                vback-porch = <23>;
                                vfront-porch = <12>;
                                vsync-len = <10>;

                                hsync-active = <1>;
                                vsync-active = <1>;
                                de-active = <1>;
                                pixelclk-active = <0>;
                        };
                };
        };
};
